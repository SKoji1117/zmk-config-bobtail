## config/west.yml
```yaml
manifest:  
  remotes:  
    - name: zmkfirmware  
      url-base: https://github.com/zmkfirmware  
    - name: na-ka-no
      url-base: https://github.com/na-ka-no
  
  projects:  
    - name: zmk
      remote: na-ka-no  # フォークしたリポジトリを参照  
      revision: 1574f6b2d015d4cb32920aa550ea91869451728c  # for-cool642tb_mini ブランチの 2026-10-04 時点
      import: app/west.yml  
    - name: zmk-pmw3610-driver  
      remote: na-ka-no
      revision: 5e04553ab803d24405bd45621a41310ea3050e59  # main ブランチの 2026-10-04 時点
  
  self:  
    path: config
```
